## sdkconfig.defaults
```kconfig
# Build for ESP32-S3 by default
CONFIG_IDF_TARGET="esp32s3"

# Flash size and partition table settings
CONFIG_ESPTOOLPY_FLASHSIZE_4MB=y
CONFIG_ESPTOOLPY_FLASHMODE_QIO=y
CONFIG_PARTITION_TABLE_CUSTOM=y

# PSRAM settings
CONFIG_SPIRAM=y
CONFIG_SPIRAM_MODE_OCT=y
CONFIG_SPIRAM_SPEED_80M=y

# Performance-related settings
CONFIG_COMPILER_OPTIMIZATION_PERF=y
CONFIG_ESP_DEFAULT_CPU_FREQ_MHZ_240=y
CONFIG_ESP32S3_INSTRUCTION_CACHE_32KB=y
CONFIG_ESP32S3_DATA_CACHE_64KB=y
CONFIG_FREERTOS_HZ=1000

# Filesystem settings
CONFIG_FATFS_LFN_HEAP=y

# Debugging
CONFIG_FREERTOS_WATCHPOINT_END_OF_STACK=y

# LVGL settings
# 1. Performance
CONFIG_LV_MEM_CUSTOM=y
CONFIG_LV_MEMCPY_MEMSET_STD=y
# 2. Filesystem support
CONFIG_LV_USE_FS_POSIX=y
CONFIG_LV_FS_POSIX_LETTER=65
# 3. PNG support
CONFIG_LV_USE_PNG=y
```
